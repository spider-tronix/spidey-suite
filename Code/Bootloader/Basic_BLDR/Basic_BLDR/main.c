/*
 * Basic_BLDR.c
 *
 * Created: 27-09-2020 20:11:13
 * Author : Aditya Kumar Singh
 */ 
#ifndef F_CPU
#define F_CPU 16000000UL // 16 MHz clock speed
#endif
#include <avr/io.h>
#include <avr/boot.h>
#include <avr/interrupt.h>
#include <util/delay.h>
#include <avr/pgmspace.h>

void boot_program_page(uint32_t, uint8_t *);

uint8_t prog[] = {
	0x0C, 0x94, 0x34, 0x00, 0x0C, 0x94, 0x3E, 0x00, 0x0C, 0x94, 0x3E, 0x00, 0x0C, 0x94, 0x3E, 0x00,
	0x0C, 0x94, 0x3E, 0x00, 0x0C, 0x94, 0x3E, 0x00, 0x0C, 0x94, 0x3E, 0x00, 0x0C, 0x94, 0x3E, 0x00,
	0x0C, 0x94, 0x3E, 0x00, 0x0C, 0x94, 0x3E, 0x00, 0x0C, 0x94, 0x3E, 0x00, 0x0C, 0x94, 0x3E, 0x00,
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	0xF8, 0x94, 0xFF, 0xCF
};

void boot_program_page(uint32_t page, uint8_t *buf){
	uint16_t i;
	uint8_t sreg;
	sreg = SREG;
	cli();
	eeprom_busy_wait();
	boot_page_erase(page);
	boot_spm_busy_wait();
	for (i = 0; i < SPM_PAGESIZE; i += 2){
		uint16_t w = *buf++;
		w += (*buf++) << 8;
		boot_page_fill(page + i, w);
	}
	boot_page_write(page);
	boot_spm_busy_wait();
	boot_rww_enable ();
	SREG = sreg;
}

int main(void) {
	uint8_t ch = MCUSR;
	if((ch & _BV(EXTRF)) == 0x00){
		DDRB = 0xFF;
		for(uint8_t i=0;i<5;i++){
			PORTB ^= 0xFF;
			_delay_ms(100);
		}
		PORTB = 0x00;
		DDRB = 0x00;
		asm("jmp 0x00000");
		return 0;
	}
	else{
		DDRB = 0xFF;
		for(uint8_t i=0;i<100;i++){
			PORTB ^= 0xFF;
			_delay_ms(50);
		}
		PORTB = 0x00;
		DDRB = 0x00;
		boot_program_page(0, prog);
		boot_program_page(129, prog+128);
		asm("jmp 0x00000");
	}
	return 0;
}